## app/src/split/wired/Kconfig
```kconfig
if ZMK_SPLIT_WIRED

choice ZMK_SPLIT_WIRED_UART_MODE_DEFAULT
    prompt "Default UART Mode"
    default ZMK_SPLIT_WIRED_UART_MODE_DEFAULT_INTERRUPT if SERIAL_SUPPORT_INTERRUPT

config ZMK_SPLIT_WIRED_UART_MODE_DEFAULT_POLLING
    bool "Polling Mode"

config ZMK_SPLIT_WIRED_UART_MODE_DEFAULT_INTERRUPT
    bool "Interrupt Mode"
    select UART_INTERRUPT_DRIVEN

endchoice

if ZMK_SPLIT_WIRED_UART_MODE_DEFAULT_POLLING

config ZMK_SPLIT_WIRED_POLLING_RX_PERIOD
    int "Ticks between RX polls"

endif

config ZMK_SPLIT_WIRED_CMD_BUFFER_ITEMS
    int "Number of central commands to buffer for TX/RX"

config ZMK_SPLIT_WIRED_EVENT_BUFFER_ITEMS
    int "Number of peripheral events to buffer for TX/RX"

endif
```

## app/src/split/wired/Kconfig.defaults
```kconfig
if ZMK_SPLIT_WIRED

config ZMK_SPLIT_WIRED_CMD_BUFFER_ITEMS
    default 4

config ZMK_SPLIT_WIRED_EVENT_BUFFER_ITEMS
    default 16


if ZMK_SPLIT_WIRED_UART_MODE_DEFAULT_POLLING

config ZMK_SPLIT_WIRED_POLLING_RX_PERIOD
    default 10

endif

endif
```

## app/west.yml
```yaml
manifest:
  remotes:
    - name: zephyrproject-rtos
      url-base: https://github.com/zephyrproject-rtos
    - name: zmkfirmware
      url-base: https://github.com/zmkfirmware
    - name: paulshir
      url-base: https://github.com/paulshir
  projects:
    - name: zephyr
      remote: paulshir
      revision: v3.5.0+zmk-fixes+pio-led
      clone-depth: 1
      import:
        name-blocklist:
          - ci-tools
          - hal_altera
          - hal_cypress
          - hal_infineon
          - hal_microchip
          - hal_nxp
          - hal_openisa
          - hal_silabs
          - hal_xtensa
          - hal_st
          - hal_ti
          - loramac-node
          - mcuboot
          - mcumgr
          - net-tools
          - openthread
          - edtt
          - trusted-firmware-m
  self:
    west-commands: scripts/west-commands.yml
```
