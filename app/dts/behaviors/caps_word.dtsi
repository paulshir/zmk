/*
 * Copyright (c) 2021 The ZMK Contributors
 *
 * SPDX-License-Identifier: MIT
 */

#include <dt-bindings/zmk/behaviors.h>
#include <dt-bindings/zmk/keys.h>

/ {
	behaviors {
#if ZMK_BEHAVIOR_OMIT(CAPS_WORD)
		/omit-if-no-ref/
#endif
		caps_word: behavior_caps_word {
			compatible = "zmk,behavior-caps-word";
			label = "CAPS_WORD";
			#binding-cells = <0>;
			mods = <MOD_LSFT>;
			continue-list = <UNDERSCORE BACKSPACE DELETE>;
			ignore-alphas;
			ignore-numbers;
			ignore-modifiers;
		};
	};

	behaviors {
#if ZMK_BEHAVIOR_OMIT(CAPS_WORD)
		/omit-if-no-ref/
#endif
		num_word: behavior_num_word {
			compatible = "zmk,behavior-caps-word";
			label = "NUM_WORD";
			#binding-cells = <0>;
			// layers = <xx>; // to be specified in user config using "&num_word { layers = <xx>; };"
			continue-list = <BACKSPACE DELETE DOT COMMA>;
			ignore-numbers;
		};
	};
};

